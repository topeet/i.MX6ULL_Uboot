## uboot-imx-rel_imx_4.1.15_2.1.0_ga/board/freescale/mx6ul_topeet/Kconfig
```kconfig
if TARGET_MX6UL_TOPEET

config SYS_BOARD
	default "mx6ul_topeet"

config SYS_VENDOR
	default "freescale"

config SYS_CONFIG_NAME
	default "mx6ul_topeet"

endif
```

## uboot-imx-rel_imx_4.1.15_2.1.0_ga/configs/mx6ul_topeet_emmc_defconfig
```kconfig
CONFIG_ARM=y
CONFIG_ARCH_MX6=y
CONFIG_TARGET_MX6UL_TOPEET=y
CONFIG_SYS_EXTRA_OPTIONS="IMX_CONFIG=board/freescale/mx6ul_topeet/imximage.cfg,MX6UL_EVK_EMMC_REWORK"
CONFIG_CMD_GPIO=y
CONFIG_CMD_DHCP=y
CONFIG_CMD_PING=y
```
